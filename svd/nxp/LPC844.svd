# LPC844 register map
Vendor: nxp.com; File version: 1.0
LPC844M201JBD48,LPC844M201JBD64,LPC844M201JHI33,LPC844M201JHI48
CPU: CM0PLUS r0p0, little endian, no MPU, no FPU, VTOR, 2 interrupt priority bits
Registers are 32-bit, read-write, reset 0x0 unless marked. A register's access mark holds for its fields unless they carry their own. Offsets are from the block's base; lines under a group give offsets from that group; [hi:lo] are bit positions; {n}, {i} and the like mark numbered series; 'fields as' and 'values as' point back to an identical list; <NAME> marks a mode.

## Memory map
0x40000000 WWDT size 0x1C — LPC84x Windowed Watchdog Timer (WWDT)
0x40004000 MRT0 size 0xFC — LPC84x Multi-Rate Timer (MRT)
0x40008000 WKT size 0x10 — LPC84x Wake Up Timer(WKT)
0x4000C000 SWM0 size 0x1C8 — LPC84x SWM
0x4001C000 ADC0 size 0x70 — LPC84x 12-bit ADC controller (ADC)
0x40020000 PMU size 0x18 — LPC84x PMU
0x40024000 ACOMP size 0x8 — LPC84x analog comparator
0x4002C000 INPUTMUX size 0xA4 — LPC84x Input multiplexing (INPUT MUX)
0x40038000 CTIMER0 size 0x88 — LPC184 Standard counter/timer
0x40040000 FLASH_CTRL size 0xFEC — LPC84x NVMC flash controller
0x40044000 IOCON size 0xE0 — LPC84x I/O pin configuration (IOCON)
0x40048000 SYSCON size 0x3FC — LPC84x System configuration (SYSCON)
0x40050000 I2C0 size 0x84 — LPC84x I2C-bus interfaces
0x40054000 I2C1 size 0x84 — LPC84x I2C-bus interfaces
0x40058000 SPI0 size 0x2C — LPC84x Serial Peripheral Interfaces (SPI)
0x4005C000 SPI1 size 0x2C — LPC84x Serial Peripheral Interfaces (SPI)
0x40064000 USART0 size 0x30 — LPC84x USARTs
0x40068000 USART1 size 0x30 — LPC84x USARTs
0x4006C000 USART2 size 0x30 — LPC84x USARTs
0x40070000 USART3 size 0x30 — LPC84x USARTs
0x40074000 USART4 size 0x30 — LPC84x USARTs
0x50000000 CRC size 0xC — LPC5411x CRC engine
0x50004000 SCT0 size 0x538 — LPC84x SCTimer/PWM (SCT)
0x50008000 DMA0 size 0x58C — LPC84x DMA controller
0x5000C000 MTB_SFR size 0x10 — LPC84x Micro Trace Buffer
0xA0000000 GPIO size 0x2488 — LPC84x General Purpose I/O (GPIO)
0xA0004000 PINT size 0x34 — LPC84x Pin interrupt and pattern match (PINT)

## Interrupts
0 SPI0
1 SPI1
3 USART0
4 USART1
5 USART2
7 I2C1
8 I2C0
9 SCT0
15 WKT
16 ADC0_SEQA (ADC0)
17 ADC0_SEQB (ADC0)
18 ADC0_THCMP (ADC0)
19 ADC0_OVR (ADC0)
20 DMA0
23 CTIMER0
24 PIN_INT0 (PINT)
25 PIN_INT1 (PINT)
26 PIN_INT2 (PINT)
27 PIN_INT3 (PINT)
28 PIN_INT4 (PINT)
29 PIN_INT5_DAC1 (PINT)
30 PIN_INT6_USART3 (USART3, PINT)
31 PIN_INT7_USART4 (USART4, PINT)

## Licence text in the file
The Clear BSD License Copyright 2016-2018 NXP All rights reserved. Redistribution and use in source and binary forms, with or without modification, are permitted (subject to the limitations in the disclaimer below) provided that the following conditions are met: * Redistributions of source code must retain the above copyright notice, this list of conditions and the following disclaimer. * Redistributions in binary form must reproduce the above copyright notice, this list of conditions and the following disclaimer in the documentation and/or other materials provided with the distribution. * Neither the name of the copyright holder nor the names of its contributors may be used to endorse or promote products derived from this software without specific prior written permission. NO EXPRESS OR IMPLIED LICENSES TO ANY PARTY'S PATENT RIGHTS ARE GRANTED BY THIS LICENSE. THIS SOFTWARE IS PROVIDED BY THE COPYRIGHT HOLDERS AND CONTRIBUTORS "AS IS" AND ANY EXPRESS OR IMPLIED WARRANTIES, INCLUDING, BUT NOT LIMITED TO, THE IMPLIED WARRANTIES OF MERCHANTABILITY AND FITNESS FOR A PARTICULAR PURPOSE ARE DISCLAIMED. IN NO EVENT SHALL THE COPYRIGHT HOLDER OR CONTRIBUTORS BE LIABLE FOR ANY DIRECT, INDIRECT, INCIDENTAL, SPECIAL, EXEMPLARY, OR CONSEQUENTIAL DAMAGES (INCLUDING, BUT NOT LIMITED TO, PROCUREMENT OF SUBSTITUTE GOODS OR SERVICES; LOSS OF USE, DATA, OR PROFITS; OR BUSINESS INTERRUPTION) HOWEVER CAUSED AND ON ANY THEORY OF LIABILITY, WHETHER IN CONTRACT, STRICT LIABILITY, OR TORT (INCLUDING NEGLIGENCE OR OTHERWISE) ARISING IN ANY WAY OUT OF THE USE OF THIS SOFTWARE, EVEN IF ADVISED OF THE POSSIBILITY OF SUCH DAMAGE.
